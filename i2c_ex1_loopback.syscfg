/**
 * @cliArgs --board "/boards/LAUNCHXL_F280039C" --device "F28003x" --part "F28003x_100PZ" --package "100PZ" --context "system" --product "C2000WARE@5.04.00.00"
 * @versions {"tool":"1.23.0+4000"}
 */

/**
 * Import the modules used in this configuration.
 */
const device_support = scripting.addModule("/driverlib/device_support.js");
const i2c            = scripting.addModule("/driverlib/i2c.js", {}, false);
const i2c1           = i2c.addInstance();
const sysctl         = scripting.addModule("/driverlib/sysctl.js");
const CMD            = scripting.addModule("/utilities/cmd_tool/cmd_syscfg/source/CMD");
const CMD1           = CMD.addInstance();
const CMD2           = CMD.addInstance();

/**
 * Write custom configuration values to the imported modules.
 */
i2c1.$name                       = "myI2C0";
i2c1.duty                        = "I2C_DUTYCYCLE_50";
i2c1.bitCount                    = "I2C_BITCOUNT_8";
i2c1.dataCount                   = 2;
i2c1.targetAddress               = 0x3C;
i2c1.ownAddress                  = 0x3C;
i2c1.txFifo                      = "I2C_FIFO_TX2";
i2c1.rxFifo                      = "I2C_FIFO_RX2";
i2c1.enabledFIFOInterrupts       = ["I2C_INT_RXFF","I2C_INT_TXFF"];
i2c1.emulationMode               = "I2C_EMULATION_FREE_RUN";
i2c1.loopback                    = true;
i2c1.registerInterrupts          = true;
i2c1.$hardware                   = system.deviceData.board.components.BP_SITE_1.subComponents.I2C;
i2c1.i2cFIFOInt.interruptHandler = "i2cFIFOISR";
i2c1.i2cFIFOInt.$name            = "INT_I2CA_FIFO";

CMD.activeCMD = "generic_ram_lnk";

CMD1.$name                    = "generic_ram_lnk";
CMD1.sectionMemory_text       = ["RAMGS0","RAMLS4","RAMLS5","RAMLS6","RAMLS7"];
CMD1.sectionMemory_ramfunc    = ["RAMM0"];
CMD1.sectionMemory_cinit      = ["RAMM0"];
CMD1.sectionMemory_stack      = ["RAMM1"];
CMD1.sectionMemory_init_array = ["RAMM0"];
CMD1.sectionMemory_bss        = ["RAMLS4"];
CMD1.sectionMemory_const      = ["RAMLS4"];
CMD1.sectionMemory_data       = ["RAMLS4"];
CMD1.sectionMemory_switch     = ["RAMM0"];
CMD1.sectionMemory_sysmem     = ["RAMLS4"];
CMD1.sectionRun_ramfunc       = ["RAMLS4"];

CMD2.$name                               = "generic_flash_lnk";
CMD2.sectionAlignEnable_ramfunc          = true;
CMD2.sectionAlignEnable_text             = true;
CMD2.sectionAlignEnable_binit            = true;
CMD2.sectionAlignEnable_cinit            = true;
CMD2.sectionAlignEnable_switch           = true;
CMD2.sectionAlignEnable_init_array       = true;
CMD2.sectionAlignEnable_const            = true;
CMD2.sectionAlignEnable_ovly             = true;
CMD2.sectionMemory_codestart             = "0x080000";
CMD2.sectionMemory_stack                 = ["RAMM1"];
CMD2.sectionMemory_ramfunc               = ["FLASH_BANK0_SEC1"];
CMD2.sectionMemory_text                  = ["FLASH_BANK0_SEC2","FLASH_BANK0_SEC3","FLASH_BANK0_SEC4"];
CMD2.sectionMemory_binit                 = ["FLASH_BANK0_SEC1"];
CMD2.sectionMemory_cinit                 = ["FLASH_BANK0_SEC1"];
CMD2.sectionMemory_switch                = ["FLASH_BANK0_SEC1"];
CMD2.sectionMemory_bss                   = ["RAMLS5"];
CMD2.sectionMemory_data                  = ["RAMLS5"];
CMD2.sectionMemory_sysmem                = ["RAMLS5"];
CMD2.sectionRunFromDifferentAddr_ramfunc = true;
CMD2.sectionBinit_ramfunc                = false;
CMD2.sectionMemory_init_array            = ["FLASH_BANK0_SEC1"];
CMD2.sectionMemory_const                 = ["FLASH_BANK0_SEC4"];
CMD2.sectionMemory_ovly                  = ["FLASH_BANK0_SEC1"];

/**
 * Pinmux solution for unlocked pins/peripherals. This ensures that minor changes to the automatic solver in a future
 * version of the tool will not impact the pinmux you originally saw.  These lines can be completely deleted in order to
 * re-solve from scratch.
 */
i2c1.i2c.$suggestSolution            = "I2CB";
i2c1.i2c.i2c_sdaPin.$suggestSolution = "boosterpack1.10";
i2c1.i2c.i2c_sclPin.$suggestSolution = "boosterpack1.9";
